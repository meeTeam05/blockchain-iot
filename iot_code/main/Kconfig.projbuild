## iot_code/main/Kconfig.projbuild
```kconfig
menu "Smart Air Configuration"

    config FIRMWARE_VERSION
        string "Firmware version"
        default "0.1.1"
        help
            Version current firmware.

    config SA_PROV_NAME_PREFIX
        string "BLE provisioning name prefix"
        default "SMART_AIR"
        help
            The advertised BLE name will be <prefix>_<last-3-byte-Wi-Fi-STA-MAC-hex>.

    config SA_MQTT_BROKER_URI
        string "MQTT broker URI"
        default "wss://minhnhat05.xyz/mqtt"
        help
            Full EMQX broker URI for ESP32. Default uses Cloudflare HTTPS 
            + secure WebSocket (nginx /mqtt -> EMQX:8083), avoiding port 
            forwarding or public 8883. Direct mqtts://...:8883 remains 
            optional. Runtime override: NVS device/broker_uri.

    config SA_WIFI_CONNECT_TIMEOUT_MS
        int "Wi-Fi connection timeout (ms)"
        default 30000
        range 5000 120000
        help
            Maximum time to wait for an IP address after esp_wifi_connect().

    config SA_CUSTOM_DNS_SERVER
        string "Custom DNS server"
        default "1.1.1.1"
        help
            IPv4 DNS resolver applied to WIFI_STA_DEF after the station gets
            an IP address. Use this when the upstream DHCP server advertises
            a resolver that cannot reliably resolve the MQTT TLS hostname.

    config SA_SNTP_SERVER
        string "SNTP server"
        default "pool.ntp.org"
        help
            Static SNTP server used for best-effort boot-time clock sync
            after Wi-Fi connects. This is not a hard boot dependency; when
            SNTP fails or times out, firmware continues with its existing
            build-time and MQTT set_time fallback behavior.

    config SA_SNTP_SYNC_TIMEOUT_MS
        int "SNTP sync timeout (ms)"
        default 10000
        range 1000 60000
        help
            Maximum time to wait for the one-shot SNTP sync attempt after
            Wi-Fi connects. If the timeout elapses, firmware continues boot
            without failing and falls back to existing timestamp sources.

    config SA_TIMEZONE
        string "POSIX timezone for local display time"
        default "ICT-7"
        help
            POSIX timezone string used by localtime() for TFT clock rendering.
            Keep telemetry, MQTT, set_time, and RTC timestamps as Unix UTC.
            Example: UTC+7 is "ICT-7" because POSIX timezone offsets use the
            opposite sign.

    config SA_PROV_TIMEOUT_MS
        int "BLE provisioning timeout (ms)"
        default 300000
        range 30000 600000
        help
            Maximum time to wait for the app to complete BLE provisioning.
            If the app disconnects mid-flow and never reconnects, provisioning
            fails after this timeout instead of hanging indefinitely.

    config SA_MQTT_SECRET_KEY
        string "MQTT secret key"
        default ""
        help
            Per-device secret for MQTT authentication. Sensitive - do not commit.
            Leave empty in repository builds; the current server returns the
            real secret_key once from POST /api/devices and provisioning writes
            it to NVS before the device can login to MQTT.
            Override at runtime via NVS namespace "device", key "secret_key".

    config SA_CONFIG_SELF_TEST
        bool "Enable NVS config self-test on boot"
        default n
        help
            When enabled, config_self_test() runs at startup to verify NVS
            write/read roundtrip. Disable in production.

    config SA_HTTPD_PORT
        int "HTTP server port"
        default 80
        range 1 65535
        help
            TCP port for the device's built-in HTTP API server.

    config SA_DEMO_NO_PERIPHERALS
        bool "Demo no peripherals"
        default n
        help
            Enable demo mode without physical peripherals. Uses virtual 
            telemetry data while keeping normal MQTT/TLS/auth flow and APIs. 
            Intended for ESP32-S3-DevKit-C-6R8; relay, LED, and factory reset 
            remain available if enabled.

    config SA_SENSOR_POLLING_INTERVAL
        int "Sensor Polling Interval Seconds"
        default 5
        range 1 60
        help
            Telemetry/shadow polling interval in seconds for normal and demo
            modes. The current server API and app dashboards expect frequent
            demo telemetry; 5 seconds is the recommended local/demo value.

    menu "Peripheral Enable/Disable"

        config SA_ENABLE_SHT3X
            bool "Enable SHT3x temperature/humidity sensor"
            default y
            help
                When disabled, SHT3x is not initialized and temperature/humidity
                fields in telemetry JSON are null.

        config SA_ENABLE_DS3231
            bool "Enable DS3231 RTC"
            default y
            help
                When disabled, DS3231 is not initialized. Telemetry timestamps
                fall back to system time. The MQTT set_time command still
                updates the ESP32 system clock, but it is not persisted through
                power loss without RTC hardware.

        config SA_ENABLE_ILI9225
            bool "Enable ILI9225 display"
            default n
            help
                When disabled, display initialization and drawing are skipped.

        config SA_ENABLE_SD_CARD
            bool "Enable SD card logging"
            default n
            help
                When disabled, SD card initialization and logging are skipped.

        config SA_ENABLE_CO_SENSOR
            bool "Enable GM-702B CO gas sensor"
            default n
            help
                When disabled, CO sensor is not initialized and co_ppm fields
                in telemetry JSON are null.

        config SA_ENABLE_NO2_SENSOR
            bool "Enable GM-102B NO2 gas sensor"
            default n
            help
                When disabled, NO2 sensor is not initialized and no2_ppm fields
                in telemetry JSON are null.

        config SA_ENABLE_RELAYS
            bool "Enable relay outputs"
            default n
            help
                When disabled, relay GPIOs are not configured and relay control
                commands are ignored.

        config SA_ENABLE_BUZZER
            bool "Enable buzzer"
            default n
            help
                When disabled, buzzer initialization and tone generation are skipped.

        config SA_ENABLE_AI
            bool "Enable on-device CO/NO2 early warning (QCVN 03:2019/BYT)"
            default n
            help
                QCVN STEL/TWA rule + early warning (projection OR TFLite Micro
                model on a 20 min window, every 10s). Tensor arena in PSRAM
                (internal RAM fallback). When disabled, the ai component is a
                no-op stub.

        config SA_ENABLE_BLOCKCHAIN_INCIDENT
            bool "Enable Blockchain Incident Schema v2 queue"
            default n
            depends on SA_ENABLE_AI
            help
                Queue signed v2 incidents after Gas EWS has initiated its
                local alarm. Signer provisioning refuses plaintext NVS.

        config SA_ENABLE_LED
            bool "Enable WS2812 RGB LED"
            default y
            help
                When disabled, led_init() and led_set_state() become no-ops.
                All LED status feedback is suppressed.

        config SA_ENABLE_FACTORY_RESET
            bool "Enable factory reset button"
            default y
            help
                When disabled, the factory reset button task is not started.
                The button GPIO is not configured.

    endmenu

    menu "Blockchain incidents"

        config SA_INCIDENT_QUEUE_CAPACITY
            int "Persistent incident queue capacity"
            depends on SA_ENABLE_BLOCKCHAIN_INCIDENT
            default 4
            range 1 8
            help
                Complete signed payloads retained in NVS. A full queue never
                blocks local safety alerting.

        choice SA_INCIDENT_ENV
            prompt "AirSafetyLog deployment (EIP-712 domain)"
            depends on SA_ENABLE_BLOCKCHAIN_INCIDENT
            default SA_INCIDENT_ENV_SEPOLIA
            help
                Selects the verifying contract, chain ID and domain separator
                from the generated incident_domain.h, which is produced from
                spec/incident/deployments/<env>.json by
                `node spec/incident/gen/gen-all.mjs`. Addresses are never typed
                by hand. When the selected deployment has not been recorded
                yet, the firmware logs an error and does not sign incidents.

            config SA_INCIDENT_ENV_SEPOLIA
                bool "Sepolia (spec/incident/deployments/sepolia.json)"

            config SA_INCIDENT_ENV_LOCAL
                bool "Local hardhat node (spec/incident/deployments/localhost.json)"
        endchoice

        config SA_INCIDENT_OFFLINE_BENCH
            bool "Offline Board Incident Bench Mode (TEST ONLY)"
            depends on SA_ENABLE_AI && SA_AI_REPLAY && SA_ENABLE_BLOCKCHAIN_INCIDENT
            depends on SA_ENABLE_BUZZER
            depends on NVS_ENCRYPTION
            default n
            help
                Intended only for physical bench verification. Bypasses the
                BLE/Wi-Fi provisioning dependency and starts AI replay plus
                the local production incident subsystem without a network.
                It does not bypass transition gating, evidence generation,
                signing, or encrypted-NVS persistence. MQTT delivery remains
                unavailable/offline. Never enable this in production builds.

        config SA_INCIDENT_SIGNER_PROVISION_BENCH
            bool "UART Signer Provisioning Bench Tool (TEST ONLY)"
            depends on SA_ENABLE_BLOCKCHAIN_INCIDENT
            depends on NVS_ENCRYPTION
            depends on ESP_CONSOLE_UART
            default n
            help
                Test/operator-only UART command for first-time provisioning of
                one 32-byte secp256k1 private key. The key is stored only by
                the existing production incident_provision_signer() API. Never
                enable this option in production builds, and never log the
                private key.

    endmenu

    # On-device AI
    menu "AI (on-device inference)"

        config SA_AI_ENABLED_AT_BOOT
            bool "Run AI inference by default after boot"
            depends on SA_ENABLE_AI
            default y
            help
                Not persisted to NVS; a reboot always restores this default,
                even after the app toggles it with the ai_set command.

        config SA_AI_TENSOR_ARENA_SIZE
            int "TFLite Micro tensor arena size (bytes)"
            depends on SA_ENABLE_AI
            default 16384
            range 4096 262144
            help
                PSRAM buffer for the interpreter (internal RAM if PSRAM is
                missing). Largest activation is ~1 KB; the boot log prints
                "arena used X/Y B" -- trim to X plus margin, or raise it if
                you see "AllocateTensors failed". The model self-test always
                runs at boot and disables only the model on a mismatch.

        config SA_AI_REPLAY
            bool "Replay simulated sensor data into the AI (bench test only)"
            depends on SA_ENABLE_AI
            default n
            help
                The AI ignores the real CO/NO2/T/RH readings and replays an
                embedded simulated scenario (components/core/ai/ai_replay_data.h)
                on a simulated 5s clock, starting 10 s after ai_start, so the
                whole alert path (model, buzzer, ai/state) can be tested on the
                board without gas. Telemetry still reports the real sensors.
                Works with SA_DEMO_NO_PERIPHERALS too. ai/state carries
                "replay":<name>; every 10s step is logged as an "RS," line.
                Expected results: components/core/ai/tools/replay/ (check a
                captured log with compare_replay_log.py).
                NEVER ship a build with this enabled.

        config SA_AI_REPLAY_SPEED
            int "Replay speed (x real time)"
            depends on SA_AI_REPLAY
            default 60
            range 1 500
            help
                1 = real time (co_event 72 min). 60 = co_event in ~72 s,
                still slow enough to hear the buzzer and see ai/state in the
                app. 500 = as fast as the 10 ms FreeRTOS tick allows
                (~10 s); use it only to compare numbers. Every step is still
                run through the model, whatever the speed, so the results
                are the same.

        config SA_AI_REPLAY_SCENARIO
            int "Replay scenario (0 = co_event 72 min, 1 = no2_event 88 min)"
            depends on SA_AI_REPLAY
            default 0
            range 0 1
            help
                0 co_event:  CO rises to ~140 ppm; early warning ~40 min,
                             limit exceeded ~47 min after the first sample.
                1 no2_event: NO2 rises to ~8 ppm with a 125 s sensor outage
                             in the middle (preheat restarts); early warning
                             ~45 min, limit exceeded ~64 min.

    endmenu

    # I2C Bus
    menu "I2C Bus (SHT3x + DS3231)"

        config SA_I2C_SDA_PIN
            int "I2C SDA GPIO"
            default 12
            range 1 48
            help
                GPIO for I2C SDA. Shared bus for SHT3x (0x44) and DS3231 (0x68).
                Requires 4.7K external pull-up resistor.

        config SA_I2C_SCL_PIN
            int "I2C SCL GPIO"
            default 13
            range 1 48
            help
                GPIO for I2C SCL. Shared bus for SHT3x and DS3231.
                Requires 4.7K external pull-up resistor.

        config SA_I2C_FREQ_HZ
            int "I2C FREQ HZ"
            default 400000
            range 400000 400000
            help
                Fixed 400 kHz - do not change

        config SA_I2C_TIMEOUT_MS
            int "I2C operation timeout (ms)"
            default 1000
            range 100 5000
            help
                Timeout for I2C read/write operations in milliseconds.

    endmenu

    # Display SPI
    menu "Display SPI (SPI2_HOST - ILI9225)"

        config SA_DISP_CLK_PIN
            int "Display CLK GPIO"
            default 1
            range 1 48
            help
                SPI2_HOST clock for ILI9225 display (10 MHz).

        config SA_DISP_SDA_PIN
            int "Display SDA (MOSI) GPIO"
            default 2
            range 1 48
            help
                SPI2_HOST data out for ILI9225 display.

        config SA_DISP_RS_PIN
            int "Display RS (Data/Command) GPIO"
            default 42
            range 1 48
            help
                ILI9225 register select. HIGH = data, LOW = command.

        config SA_DISP_RST_PIN
            int "Display RST GPIO"
            default 41
            range 1 48
            help
                ILI9225 hardware reset (active low).

        config SA_DISP_CS_PIN
            int "Display CS GPIO"
            default 40
            range 1 48
            help
                ILI9225 chip select (active low).

        config SA_DISP_SPI_HZ
            int "Display SPI clock (Hz)"
            default 10000000
            range 1000000 40000000
            help
                10 MHz is the conservative default for the ILI9225 display.

        config SA_DISP_SELF_TEST
            bool "Run display self-test during boot"
            default n
            help
                Show a short color and orientation sequence before the normal
                UI starts. Useful for bench validation of panel wiring,
                color order, and LVGL rotation.

        config SA_DISP_SELF_TEST_HOLD_MS
            int "Display self-test hold per screen (ms)"
            default 700
            range 100 5000
            depends on SA_DISP_SELF_TEST
            help
                How long each self-test screen remains visible.

    endmenu

    # SD Card SPI
    menu "SD Card SPI (SPI3_HOST)"

        config SA_SD_MISO_PIN
            int "SD Card MISO GPIO"
            default 4
            range 1 48
            help
                SPI3_HOST data in from SD card.
                Separate SPI host from display - different SPI mode.

        config SA_SD_SCK_PIN
            int "SD Card SCK GPIO"
            default 5
            range 1 48
            help
                SPI3_HOST clock for SD card.

        config SA_SD_MOSI_PIN
            int "SD Card MOSI GPIO"
            default 6
            range 1 48
            help
                SPI3_HOST data out to SD card.

        config SA_SD_CS_PIN
            int "SD Card CS GPIO"
            default 7
            range 1 48
            help
                SD card chip select (active low).

    endmenu

    # Analog Sensors
    menu "Analog Sensors (ADC1 - WiFi safe)"

        config SA_CO_ANALOG_PIN
            int "CO sensor analog GPIO"
            default 9
            range 1 10
            help
                ADC1 input for CO gas sensor analog output.
                MUST be GPIO 1-10 (ADC1). ADC2 (GPIO 11-20) is unavailable

        config SA_NO2_ANALOG_PIN
            int "NO2 sensor analog GPIO"
            default 10
            range 1 10
            help
                ADC1 input for NO2 gas sensor analog output.
                MUST be GPIO 1-10 (ADC1). Must differ from CO pin.

    endmenu

    # Relay Outputs
    menu "Relay Outputs"

        config SA_RELAY_1_PIN
            int "Relay 1 GPIO"
            default 17
            range 1 48
            help
                GPIO output for relay channel 1. Active high.

        config SA_RELAY_2_PIN
            int "Relay 2 GPIO"
            default 18
            range 1 48
            help
                GPIO output for relay channel 2. Active high.

        config SA_RELAY_3_PIN
            int "Relay 3 GPIO"
            default 8
            range 1 48
            help
                GPIO output for relay channel 3. Active high.

    endmenu

    # Single-pin peripherals

    config SA_BUZZER_PIN
        int "Buzzer GPIO"
        default 11
        range 1 48
        help
            GPIO for buzzer output. Uses LEDC PWM for tone generation.

    config SA_LED_PIN
        int "RGB LED GPIO (WS2812)"
        default 48
        range 1 48
        help
            GPIO 48 = onboard LED on ESP32-S3-DevKitC-1.

    config SA_FACTORY_RESET_PIN
        int "Factory reset button GPIO"
        default 0
        range 0 48
        help
            GPIO for factory reset button. Active-low with internal pull-up.
            Hold for SA_FACTORY_RESET_HOLD_MS to clear Wi-Fi/MQTT/device-mode/
            relay provisioning state and reboot. Blockchain signer, incident
            queue, and the separate calibration partition are preserved.

    config SA_FACTORY_RESET_HOLD_MS
        int "Factory reset hold duration (ms)"
        default 5000
        range 3000 10000
        help
            How long the button must be held to trigger factory reset.
            LED blinks red after 1s of holding as user feedback.

endmenu
```
